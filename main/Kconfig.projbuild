## main/Kconfig.projbuild
```kconfig
menu "Digilog Desk Robot"

config OTA_URL
    string "Default OTA URL"
    default "https://api.tenclass.net/xiaozhi/ota/"
    help
        The application will access this URL to check for new firmware.

choice BOARD_TYPE
    prompt "Target Board"
    default BOARD_TYPE_DIGILOG_S3CAM_OLED if IDF_TARGET_ESP32S3
    help
        Select the board hardware configuration.

    config BOARD_TYPE_DIGILOG_S3CAM_OLED
        bool "Digilog ESP32-S3-CAM + 0.96 OLED Desk Robot"
        depends on IDF_TARGET_ESP32S3
        help
            Digilog desk robot with:
            - ESP32-S3 with 16MB flash and PSRAM
            - 0.96" SSD1306 OLED display (128x64, I2C)
            - OV2640 camera (onboard ESP32-S3-CAM)
            - INMP441 I2S microphone
            - MAX98357A I2S amplifier
            - Dual SG90 servos (yaw/base + pitch/head)
endchoice

choice OLED_TYPE
    prompt "OLED Display Type"
    default OLED_SSD1306_128X64
    depends on BOARD_TYPE_DIGILOG_S3CAM_OLED
    help
        Select the OLED display type.

    config OLED_SSD1306_128X32
        bool "SSD1306 128x32"
    config OLED_SSD1306_128X64
        bool "SSD1306 128x64"
    config OLED_SH1106_128X64
        bool "SH1106 128x64"
endchoice

choice
    prompt "Default Language"
    default LANGUAGE_EN_US
    help
        Select device display language.

    config LANGUAGE_ZH_CN
        bool "Chinese (Simplified)"
    config LANGUAGE_EN_US
        bool "English (US)"
    config LANGUAGE_JA_JP
        bool "Japanese"
endchoice

config SERVO_YAW_DEFAULT_ANGLE
    int "Servo Yaw Default Angle (0-180)"
    default 90
    range 0 180
    depends on BOARD_TYPE_DIGILOG_S3CAM_OLED
    help
        Default center angle for the yaw/base servo.

config SERVO_PITCH_DEFAULT_ANGLE
    int "Servo Pitch Default Angle (0-180)"
    default 90
    range 0 180
    depends on BOARD_TYPE_DIGILOG_S3CAM_OLED
    help
        Default center angle for the pitch/head servo.

config DIGILOG_FACE_ENABLE
    bool "Enable DigilogFace robot face UI"
    default y
    depends on BOARD_TYPE_DIGILOG_S3CAM_OLED
    help
        Enable the custom robot face display instead of text UI.
        Disable to use standard Xiaozhi OLED text display.

endmenu
```

## sdkconfig.defaults
```kconfig
# Digilog S3CAM OLED common defaults

# Project configuration
CONFIG_ESPTOOLPY_FLASHSIZE_16MB=y
CONFIG_ESPTOOLPY_FLASHMODE_DIO=y
CONFIG_PARTITION_TABLE_CUSTOM=y
CONFIG_PARTITION_TABLE_CUSTOM_FILENAME="partitions/digilog_16mb.csv"

# System configuration
CONFIG_ESP_TASK_WDT_PANIC=y
CONFIG_ESP_TASK_WDT_CHECK_IDLE_TASK_CPU0=n
CONFIG_ESP_TASK_WDT_CHECK_IDLE_TASK_CPU1=n

# Memory / PSRAM (ESP32-S3 has PSRAM for camera)
CONFIG_SPIRAM=y
CONFIG_SPIRAM_MODE_OCT=y
CONFIG_SPIRAM_SPEED_80M=y

# Logging
CONFIG_LOG_DEFAULT_LEVEL_INFO=y
CONFIG_LOG_MAXIMUM_LEVEL_DEBUG=y

# FreeRTOS
CONFIG_FREERTOS_HZ=1000
CONFIG_FREERTOS_USE_TRACE_FACILITY=y
CONFIG_FREERTOS_GENERATE_RUN_TIME_STATS=y

# Wi-Fi
CONFIG_ESP_WIFI_SOFTAP_SUPPORT=y
CONFIG_ESP_WIFI_NVS_ENABLED=y

# Bluetooth (for provisioning)
CONFIG_BT_ENABLED=y
CONFIG_BT_NIMBLE_ENABLED=y

# HTTPS/TLS
CONFIG_MBEDTLS_CERTIFICATE_BUNDLE=y
CONFIG_MBEDTLS_CERTIFICATE_BUNDLE_DEFAULT_FULL=y

# LEDC (for servos)
CONFIG_LEDC_CTRL_FUNC_EN=y

# Camera
CONFIG_CAMERA_MODULE_ESP32S3_EYE=n

# LVGL
CONFIG_LV_USE_FONT_PLACEHOLDER=y

# Application
CONFIG_OTA_URL="https://api.tenclass.net/xiaozhi/ota/"
```

## sdkconfig.defaults.esp32s3
```kconfig
# ESP32-S3 specific settings for Digilog S3CAM OLED

# Target
CONFIG_IDF_TARGET="esp32s3"

# OLED Display (SSD1306 128x64)
CONFIG_OLED_SSD1306_128X64=y

# Board selection
CONFIG_BOARD_TYPE_DIGILOG_S3CAM_OLED=y

# ESP32-S3 specific optimizations
CONFIG_ESP32S3_DEFAULT_CPU_FREQ_240=y
CONFIG_ESP32S3_INSTRUCTION_CACHE_32KB=y
CONFIG_ESP32S3_DATA_CACHE_64KB=y
CONFIG_ESP32S3_DATA_CACHE_LINE_64B=y

# I2S for audio
CONFIG_I2S_ISR_IRAM_SAFE=y
```
